## boards/shields/nice_oled/Kconfig.defconfig
```kconfig
if SHIELD_NICE_OLED

# --- Disable Gem animation ---
config NICE_OLED_GEM_ANIMATION
    bool "Enable Gem Animation"
    default n

config NICE_OLED_GEM_ANIMATION_SMART_BATTERY
    bool "Enable Smart Battery Animation"
    default n

# --- WPM / Luna ---
config NICE_OLED_WIDGET_WPM
    bool "Enable WPM Widget"
    default y

if NICE_OLED_WIDGET_WPM
    config NICE_OLED_WIDGET_WPM_LUNA
        bool "Enable WPM Luna"
        default y
    if NICE_OLED_WIDGET_WPM_LUNA
        config NICE_OLED_WIDGET_WPM_LUNA_ANIMATION_MS
            int "Luna Animation in ms for WPM Widget"
            default 300
    endif
endif

# --- HID indicators ---
config NICE_OLED_WIDGET_HID_INDICATORS
    bool "Enable HID indicators"
    default y

if NICE_OLED_WIDGET_HID_INDICATORS
    config ZMK_HID_INDICATORS
        bool "Enable HID indicators"
        default y
    config NICE_OLED_WIDGET_HID_INDICATORS_LUNA
        bool "Enable Luna for HID indicators"
        default y
    config NICE_OLED_WIDGET_HID_INDICATORS_LUNA_ONLY_CAPSLOCK
        bool "Show only CapsLock"
        default n
    if NICE_OLED_WIDGET_HID_INDICATORS_LUNA
        config NICE_OLED_WIDGET_HID_INDICATORS_LUNA_ANIMATION_MS
            int "Luna Animation in ms for HID Indicators"
            default 300
    endif
endif

# --- Modifiers indicators ---
config NICE_OLED_WIDGET_MODIFIERS_INDICATORS
    bool "Enable Modifiers indicators"
    default y

if NICE_OLED_WIDGET_MODIFIERS_INDICATORS
    config NICE_OLED_WIDGET_MODIFIERS_INDICATORS_LUNA
        bool "Enable Luna for Modifiers"
        default y
    if NICE_OLED_WIDGET_MODIFIERS_INDICATORS_LUNA
        config NICE_OLED_WIDGET_MODIFIERS_INDICATORS_LUNA_ANIMATION_MS
            int "Luna Animation in ms for Modifiers Indicators"
            default 300
    endif
endif

# --- Other OLED options ---
config NICE_OLED_POKEMON_ANIMATION
    bool "Enable Pokémon animation"
    default n

config NICE_OLED_POKEMON_ANIMATION_MS
    int "Animation length in milliseconds"
    default 4800

config NICE_OLED_VIM
    bool "Enable static vim on peripheral"
    default n

config NICE_OLED_VIP_MARCOS
    bool "Enable static vim_marcos on peripheral"
    default n

endif # SHIELD_NICE_OLED
```

## config/west.yml
```yaml
manifest:
  defaults:
    revision: v0.3
  remotes:
    - name: zmkfirmware
      url-base: https://github.com/zmkfirmware
    # dongle_display
    - name: englmaxi
      url-base: https://github.com/englmaxi
    # nice_oled - nice_epaper - dongle_display!view - oled Adapter
    - name: mctechnology17
      url-base: https://github.com/mctechnology17
  projects:
    - name: zmk
      remote: zmkfirmware
      import: app/west.yml
    - name: zmk-nice-oled
      url: https://github.com/mctechnology17/zmk-nice-oled.git
      revision: main
      path: modules/zmk-nice-oled
    # dongle_display
    - name: zmk-dongle-display
      remote: englmaxi
      revision: main
    # dongle_display!view
    - name: zmk-dongle-display-view
      remote: mctechnology17
      revision: main
    # oled Adapter
    - name: zmk-oled-adapter
      remote: mctechnology17
      revision: main
  self:
    path: config
```
